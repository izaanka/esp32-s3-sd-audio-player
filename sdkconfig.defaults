## sdkconfig.defaults
```kconfig
# =====================================================
# ESP-IDF Sound Player — sdkconfig.defaults
# Target: ESP32-S3 N16R8
# =====================================================

# --- Target ---
CONFIG_IDF_TARGET="esp32s3"

# --- Flash ---
CONFIG_ESPTOOLPY_FLASHSIZE_16MB=y
CONFIG_PARTITION_TABLE_CUSTOM=n

# --- PSRAM (Octal, N16R8) ---
CONFIG_SPIRAM=y
CONFIG_SPIRAM_MODE_OCT=y
CONFIG_SPIRAM_SPEED_80M=y

# --- FreeRTOS ---
CONFIG_FREERTOS_HZ=1000

# --- FATFS (SD Card) ---
CONFIG_FATFS_LONG_FILENAMES=y
CONFIG_FATFS_MAX_LFN=255
CONFIG_FATFS_LFN_HEAP=y
CONFIG_FATFS_API_ENCODING_UTF_8=y

# --- I2C ---
CONFIG_I2C_ISR_IRAM_SAFE=n

# --- Log Level ---
CONFIG_LOG_DEFAULT_LEVEL_INFO=y
CONFIG_LOG_MAXIMUM_LEVEL_DEBUG=y

# --- USB Host & UAC ---
CONFIG_USB_HOST_CONTROL_TRANSFER_MAX_SIZE=2048
CONFIG_USB_HOST_HW_BUFFER_BIAS_BALANCED=n
CONFIG_USB_HOST_HW_BUFFER_BIAS_PERIODIC_OUT=y
CONFIG_ESP_CONSOLE_SECONDARY_NONE=y
CONFIG_ESP_CONSOLE_SECONDARY_USB_SERIAL_JTAG=n
```
